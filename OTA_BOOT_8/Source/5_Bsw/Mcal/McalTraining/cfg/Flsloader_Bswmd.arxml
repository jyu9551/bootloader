AUTOSAR XML (schema 4-0-3)
# Copyright (C) Infineon Technologies (2015)
# All rights reserved.
package /AURIX_Flsloader/BswModuleDescriptions
  bsw module description Flsloader: category=BSW_MODULE, module-id=255, provided-entrys=[FlsLoader_Init, FlsLoader_Write, FlsLoader_Erase, FlsLoader_Suspend]  # Flash (PFlash and Dflash) Driver
    bsw module dependency DetDependency: target-module-id=15, required-entrys=Det_ReportError
    bsw module dependency DemDependency: target-module-id=54, required-entrys=Dem_ReportErrorStatus
    bsw internal behavior FlsloaderBehavior
      static-memorys:
        data FlsLoader_Status: implementation-data-type=uint8, type=uint8
        data FlsLoader_InitStatus: implementation-data-type=uint8, type=uint8
      4 x bsw called entity:
        FlsLoader_Init: implemented-entry=FlsLoader_Init
        FlsLoader_Write: implemented-entry=FlsLoader_Write
        FlsLoader_Erase: implemented-entry=FlsLoader_Erase
        FlsLoader_Suspend: implemented-entry=FlsLoader_Suspend
package /AURIX_Flsloader/BswModuleEntrys
  4 x bsw module entry, all with is-reentrant=false, is-synchronous=true, call-type=REGULAR, execution-context=TASK, sw-service-impl-policy=STANDARD:
    FlsLoader_Init: service-id=0
      return type Return: implementation-data-type=FlsLoader_ReturnType
      sw service arg Address: category=DATA_REFERENCE, sw-pointer-target-props={target-category=TYPE_REFERENCE, implementation-data-type=FlsLoader_ConfigType}
    FlsLoader_Write: service-id=2
      return type Return: implementation-data-type=FlsLoader_ReturnType
      sw service arg TargetAddress: implementation-data-type=FlsLoader_AddressType
      sw service arg Length: implementation-data-type=FlsLoader_LengthType
      sw service arg SourceAddressPtr: category=DATA_REFERENCE, sw-pointer-target-props={target-category=TYPE_REFERENCE, implementation-data-type=uint8}
    FlsLoader_Erase: service-id=3
      return type Return: implementation-data-type=FlsLoader_ReturnType
      sw service arg TargetAddress: implementation-data-type=FlsLoader_AddressType
      sw service arg Length: implementation-data-type=FlsLoader_LengthType
    FlsLoader_Suspend: service-id=6
      return type Return: implementation-data-type=FlsLoader_ReturnType
package /AURIX_Flsloader/Implementations
  bsw implementation Flsloader: programming-language=C, sw-version=0.0.0, vendor-id=17, ar-release-version=4.0.3, behavior=FlsloaderBehavior, vendor-specific-module-def=Flsloader
    code-descriptors:
      code Files
        artifact-descriptors:
          short-label=ssc::src::FlsLoader.c, category=SWSRC
          short-label=ssc::inc::FlsLoader.h, category=SWHDR
          short-label=mak::flsloader_infineon_tricore::ssc::mak::infineon_flsloader_cfg.mak, category=SWMAKE
          short-label=mak::flsloader_infineon_tricore::ssc::mak::infineon_flsloader_check.mak, category=SWMAKE
          short-label=mak::flsloader_infineon_tricore::ssc::mak::infineon_flsloader_defs.mak, category=SWMAKE
          short-label=mak::flsloader_infineon_tricore::ssc::mak::infineon_flsloader_rules.mak, category=SWMAKE
    compiler TASKING_COMPILE: name=TASKING, options="-c --core=tc1.6.x -t -Wa-gAHLs --emit-locals=-equ,-symbols -Wa-Ogs -Wa--error-limit=42 --iso=90 --eabi-compliant --integer-enumeration --language=-comments,-gcc,+volatile,-strings --switch=auto --align=0 --default-near-size=0 --default-a0-size=0 --default-a1-size=0 -O2ROPYG --tradeoff=4 -g --source -D_TASKING_C_TRICORE_=1 $(CALLFUNCTION)", vendor=Tasking, version=Tasking
    compiler DIAB_COMPILE: name=DIAB, options="-c -tTC27xAstep16PMG:cross -Xdialect-c89 -Xno-common -Xalign-functions=4 -Xfp-fast -Xsection-split=1 -Xkeep-assembly-file=2 -g3 -ew4084 -ei4177,4550,4549,4068,5388 -XO -D_DIABDATA_C_TRICORE_=1 $(CALLFUNCTION)", vendor=WindRiver, version=WindRiver
    compiler GNU_COMPILE:
      name=GNU
      options="-c -save-temps=obj -std=iso9899:1990 -ansi -fno-asm -ffreestanding -Wundef -Wp,-std=iso9899:1990 -fno-short-enums -fpeel-loops -falign-functions=4 -frecord-gcc-switches -fsection-anchors -funsigned-bitfields -ffunction-sections -fno-ivopts -fno-peephole2 -nostartfiles -O3 -g3 -W -Wall -Wuninitialized -DTRIBOARD_TC27XX -mcpu=tc27xx -D_GNU_C_TRICORE_=1 $(CALLFUNCTION)"
      vendor=Hightec
      version=Hightec
    generated-artifacts:
      dependency on artifact FlsLoader_Cfg_h: artifact-descriptor={short-label=generate::src::FlsLoader_Cfg.h, category=SWHDR}, usages=CODEGENERATION
      dependency on artifact FlsLoader_xdm: artifact-descriptor={short-label=config::FlsLoader.xdm, category=SWTOOL}, usages=CODEGENERATION
      dependency on artifact FlsLoader_bmd: artifact-descriptor={short-label=autosar::FlsLoader.bmd, category=SWTOOL}, usages=CODEGENERATION
    linker TASKING_LINK: name=TASKING, options="-t -d_mcal_pjt.lsl -D__CPU__=tc27x -Cmpe:vtc -Otxycl --error-limit=42 -M -mcrfiklsmnoduq -lc -lfp -lrt", vendor=Tasking, version=Tasking
    linker DIAB_LINK: name=DIAB, options="-m6 "_mcal_pjt.dld" -lc", vendor=WindRiver, version=WindRiver
    linker GNU_LINK: name=GNU, options="-T"_mcal_pjt.ld" -nostartfiles -Wl,--allow-multiple-definition -Wl,--cref -Wl,--oformat=elf32-tricore -Wl,--mcpu=tc161 -Wl,--mem-holes -Wl,--extmap="a"", vendor=Hightec, version=Hightec
    resource consumption ResourceConsumption
      5 x memory section:
        FLSLOADER_CONST_32BIT: alignment=32, size=352, sw-addrmethod=CONST
        FLSLOADER_VAR_32BIT: alignment=32, size=84, sw-addrmethod=VAR
        FLSLOADER_VAR_8BIT: alignment=8, size=2, sw-addrmethod=VAR
        FLSLOADER_START_SEC_CODE: alignment=UNSPECIFIED, size=2550, sw-addrmethod=CODE
        FLSLOADER_START_SEC_WRITE_CODE: alignment=UNSPECIFIED, size=1138, sw-addrmethod=CODE
      section name prefix FLSLOADER
package /AURIX_Flsloader/ImplementationDataTypes
  5 x impl type, all with category=TYPE_REFERENCE, implementation-data-type=uint32, type-emitter=BSW:
    FlsLoader_ValueType
    FlsLoader_AddressType
    FlsLoader_LengthType
    FlsLoader_ReturnType
    FlsLoader_ConfigType
