AUTOSAR XML (schema 4-0-3)
# Copyright (C) Infineon Technologies (2015)
# All rights reserved.
package /AUTOSAR_Gpt/BswModuleDescriptions
  bsw module description Gpt: category=BSW_MODULE, module-id=100  # GPT Driver
    provided-entrys:
      Gpt_Init
      Gpt_DeInit
      Gpt_GetTimeRemaining
      Gpt_StartTimer
      Gpt_StopTimer
      Gpt_EnableNotification
      Gpt_DisableNotification
      Gpt_InitCheck
      Gpt_GetMode
      Gpt_Isr
    bsw module dependency DetDependency: target-module-id=15, required-entrys=Det_ReportError
    bsw module dependency SafeMcalDependency: target-module-id=255, required-entrys=SafeMcal_ReportError
    bsw internal behavior GptBehavior
      constant-memorys:
        parameter data prototype Gpt_kConfigPtr: category=DATA_REFERENCE, sw-pointer-target-props={target-category=TYPE_REFERENCE, implementation-data-type=Gpt_ConfigType}, type=Gpt_ConfigType
      static-memorys:
        8 x data:
          Gpt_DriverMode: implementation-data-type=uint8, type=uint8
          Gpt_AsilChannelStatus: implementation-data-type=uint8, type=uint8
          Gpt_QMChannelStatus: implementation-data-type=uint8, type=uint8
          Gpt_AsilFlag: implementation-data-type=uint8, type=uint8
          Gpt_QMFlag: implementation-data-type=uint8, type=uint8
          Gpt_ChannelIndex: implementation-data-type=uint8, type=uint8
          Gpt_ChannelIdentifier: implementation-data-type=Gpt_ChannelIdentifierType, type=Gpt_ChannelIdentifierType
          Gpt_WakeupChannelInfo: implementation-data-type=EcuM_WakeupSourceType, type=EcuM_WakeupSourceType
      9 x bsw called entity:
        Gpt_Init: implemented-entry=Gpt_Init
        Gpt_DeInit: implemented-entry=Gpt_DeInit
        Gpt_GetTimeRemaining: implemented-entry=Gpt_GetTimeRemaining
        Gpt_StartTimer: implemented-entry=Gpt_StartTimer
        Gpt_StopTimer: implemented-entry=Gpt_StopTimer
        Gpt_EnableNotification: implemented-entry=Gpt_EnableNotification
        Gpt_DisableNotification: implemented-entry=Gpt_DisableNotification
        Gpt_InitCheck: implemented-entry=Gpt_InitCheck
        Gpt_GetMode: implemented-entry=Gpt_GetMode
      bsw interrupt entity Gpt_Isr: implemented-entry=Gpt_Isr, interrupt-category=CAT-1, interrupt-source=SRC_GTM(A)TOMxy
package /AUTOSAR_Gpt/BswModuleEntrys
  10 x bsw module entry, all with is-synchronous=true, sw-service-impl-policy=STANDARD:
    Gpt_Init: service-id=1, is-reentrant=false, call-type=REGULAR, execution-context=TASK
      sw service arg ConfigPtr: category=DATA_REFERENCE, sw-pointer-target-props={target-category=TYPE_REFERENCE, implementation-data-type=Gpt_ConfigType}
    Gpt_DeInit: service-id=2, is-reentrant=false, call-type=REGULAR, execution-context=UNSPECIFIED
    Gpt_GetTimeRemaining: service-id=4, is-reentrant=true, call-type=REGULAR, execution-context=UNSPECIFIED
      return type Return: implementation-data-type=Gpt_ValueType
      sw service arg Channel: implementation-data-type=Gpt_ChannelType
    Gpt_StartTimer: service-id=5, is-reentrant=true, call-type=REGULAR, execution-context=UNSPECIFIED
      sw service arg Channel: implementation-data-type=Gpt_ChannelType
      sw service arg Value: implementation-data-type=Gpt_ValueType
    Gpt_StopTimer: service-id=6, is-reentrant=true, call-type=REGULAR, execution-context=UNSPECIFIED
      sw service arg Channel: implementation-data-type=Gpt_ChannelType
    Gpt_EnableNotification: service-id=7, is-reentrant=true, call-type=REGULAR, execution-context=UNSPECIFIED
      sw service arg Channel: implementation-data-type=Gpt_ChannelType
    Gpt_DisableNotification: service-id=8, is-reentrant=true, call-type=REGULAR, execution-context=UNSPECIFIED
      sw service arg Channel: implementation-data-type=Gpt_ChannelType
    Gpt_InitCheck: service-id=0, is-reentrant=false, call-type=REGULAR, execution-context=UNSPECIFIED
      return type Return: implementation-data-type=Std_ReturnType
      sw service arg ConfigPtr: category=DATA_REFERENCE, sw-pointer-target-props={target-category=TYPE_REFERENCE, implementation-data-type=Gpt_ConfigType}
    Gpt_GetMode: service-id=0, is-reentrant=true, call-type=REGULAR, execution-context=UNSPECIFIED
    Gpt_Isr: service-id=13, is-reentrant=true, call-type=INTERRUPT, execution-context=INTERRUPT-CAT-1
      sw service arg ModuleType: implementation-data-type=uint8
      sw service arg ModuleNo: implementation-data-type=uint8
      sw service arg ChannelNo: implementation-data-type=uint8
package /AUTOSAR_Gpt/Implementations
  bsw implementation Gpt: programming-language=C, sw-version=0.0.0, vendor-id=17, ar-release-version=4.0.3, behavior=GptBehavior, vendor-specific-module-def=Gpt
    code-descriptors:
      code Files
        artifact-descriptors:
          short-label=ssc::src::Gpt.c, category=SWSRC
          short-label=ssc::src::Gpt_Ver.c, category=SWSRC
          short-label=ssc::inc::Gpt.h, category=SWHDR
          short-label=ssc::inc::Gpt_Local.h, category=SWHDR
          short-label=mak::gpt_infineon_tricore::ssc::mak::infineon_gpt_cfg.mak, category=SWMAKE
          short-label=mak::gpt_infineon_tricore::ssc::mak::infineon_gpt_check.mak, category=SWMAKE
          short-label=mak::gpt_infineon_tricore::ssc::mak::infineon_gpt_defs.mak, category=SWMAKE
          short-label=mak::gpt_infineon_tricore::ssc::mak::infineon_gpt_rules.mak, category=SWMAKE
    compiler TASKING_COMPILE: name=TASKING, options="-c --core=tc1.6.x -t -Wa-gAHLs --emit-locals=-equ,-symbols -Wa-Ogs -Wa--error-limit=42 --iso=90 --eabi-compliant --integer-enumeration --language=-comments,-gcc,+volatile,-strings --switch=auto --align=0 --default-near-size=0 --default-a0-size=0 --default-a1-size=0 -O2ROPYG --tradeoff=4 -g --source -D_TASKING_C_TRICORE_=1 $(CALLFUNCTION)", vendor=Tasking, version=Tasking
    compiler DIAB_COMPILE: name=DIAB, options="-c -tTC27xAstep16PMG:cross -Xdialect-c89 -Xno-common -Xalign-functions=4 -Xfp-fast -Xsection-split=1 -Xkeep-assembly-file=2 -g3 -ew4084 -ei4177,4550,4549,4068,5388 -XO -D_DIABDATA_C_TRICORE_=1 $(CALLFUNCTION)", vendor=WindRiver, version=WindRiver
    compiler GNU_COMPILE:
      name=GNU
      options="-c -save-temps=obj -std=iso9899:1990 -ansi -fno-asm -ffreestanding -Wundef -Wp,-std=iso9899:1990 -fno-short-enums -fpeel-loops -falign-functions=4 -frecord-gcc-switches -fsection-anchors -funsigned-bitfields -ffunction-sections -fno-ivopts -fno-peephole2 -nostartfiles -O3 -g3 -W -Wall -Wuninitialized -DTRIBOARD_TC27XX -mcpu=tc27xx -D_GNU_C_TRICORE_=1 $(CALLFUNCTION)"
      vendor=Hightec
      version=Hightec
    generated-artifacts:
      4 x dependency on artifact, all with usages=CODEGENERATION:
        Gpt_PBCfg_c: artifact-descriptor={short-label=generate::src::Gpt_PBCfg.c, category=SWSRC}
        Gpt_Cfg_h: artifact-descriptor={short-label=generate::inc::Gpt_Cfg.h, category=SWHDR}
        Gpt_xdm: artifact-descriptor={short-label=config::Gpt.xdm, category=SWTOOL}
        Gpt_bmd: artifact-descriptor={short-label=autosar::Gpt.bmd, category=SWTOOL}
    linker TASKING_LINK: name=TASKING, options="-t -d_mcal_pjt.lsl -D__CPU__=tc27x -Cmpe:vtc -Otxycl --error-limit=42 -M -mcrfiklsmnoduq -lc -lfp -lrt", vendor=Tasking, version=Tasking
    linker DIAB_LINK: name=DIAB, options="-m6 "_mcal_pjt.dld" -lc", vendor=WindRiver, version=WindRiver
    linker GNU_LINK: name=GNU, options="-T"_mcal_pjt.ld" -nostartfiles -Wl,--allow-multiple-definition -Wl,--cref -Wl,--oformat=elf32-tricore -Wl,--mcpu=tc161 -Wl,--mem-holes -Wl,--extmap="a"", vendor=Hightec, version=Hightec
    resource consumption ResourceConsumption
      8 x memory section:
        GPT_VAR_32BIT: alignment=32, size=20, sw-addrmethod=VAR
        GPT_CONST_32BIT: alignment=32, size=20, sw-addrmethod=CONST
        GPT_VAR_8BIT: alignment=8, size=8, sw-addrmethod=VAR
        GPT_ASIL0_VAR_8BIT: alignment=8, size=2, sw-addrmethod=VAR
        GPT_VAR_FAST_32BIT: alignment=32, size=4, sw-addrmethod=VAR_FAST
        GPT_CODE: alignment=UNSPECIFIED, size=2776, sw-addrmethod=CODE
        GPT_POSTBUILDCFG: alignment=UNSPECIFIED, size=16, sw-addrmethod=CONFIG_DATA
        GPT_CALLOUT_CODE: alignment=UNSPECIFIED, size=274, sw-addrmethod=CODE
      section name prefix GPT
package /AUTOSAR_Gpt/ImplementationDataTypes
  7 x impl type, all with type-emitter=BSW:
    Gpt_ConfigType: category=STRUCTURE
      element Gpt_ChannelConfigType*
    Gpt_ChannelType: implementation-data-type=uint8
    Gpt_ModeType: implementation-data-type=uint8
    Gpt_ValueType: implementation-data-type=uint32
    Gpt_ClockType: implementation-data-type=uint8
    Gpt_SignalType: implementation-data-type=uint8
    Gpt_ChannelIdentifierType: category=STRUCTURE
      element uint8
