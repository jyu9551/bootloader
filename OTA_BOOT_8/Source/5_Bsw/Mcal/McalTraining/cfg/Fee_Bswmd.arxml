AUTOSAR XML (schema 4-0-3)
# Copyright (C) Infineon Technologies (2015)
# All rights reserved.
package /AUTOSAR_Fee/BswModuleDescriptions
  bsw module description Fee: category=BSW_MODULE, module-id=21  # FEE Driver
    provided-entrys:
      Fee_Init
      Fee_SetMode
      Fee_Read
      Fee_Write
      Fee_Cancel
      Fee_GetStatus
      Fee_GetJobResult
      Fee_InvalidateBlock
      Fee_EraseImmediateBlock
      Fee_JobEndNotification
      Fee_JobErrorNotification
      Fee_17_GetCycleCount
      Fee_17_EnableGcStart
      Fee_17_DisableGcStart
      Fee_MainFunction
      Fee_17_GetPrevData
      Fee_IllegalStateNotification
    bsw module dependency DemDependency: target-module-id=54, required-entrys=Dem_ReportErrorStatus
    bsw module dependency DetDependency: target-module-id=15, required-entrys=Det_ReportError
    bsw module dependency FlsDependency: target-module-id=92
      required-entrys:
        Fls_17_Pmu_Read
        Fls_17_Pmu_Write
        Fls_17_Pmu_Erase
        Fls_17_Pmu_ReadWordsSync
        Fls_17_Pmu_CompareWordsSync
        Fls_17_Pmu_VerifyErase
        Fls_17_Pmu_GetNotifCaller
        Fls_17_Pmu_CancelNonEraseJobs
        Fls_17_Pmu_SetMode
        Fls_17_Pmu_SuspendErase
        Fls_17_Pmu_ResumeErase
    bsw internal behavior FeeBehavior
      static-memorys:
        data Fee_CfgPtr: sw-pointer-target-props=Fee_ConfigType, type=Fee_ConfigType
      13 x bsw called entity:
        Fee_Init: implemented-entry=Fee_Init
        Fee_SetMode: implemented-entry=Fee_SetMode
        Fee_Read: implemented-entry=Fee_Read
        Fee_Write: implemented-entry=Fee_Write
        Fee_Cancel: implemented-entry=Fee_Cancel
        Fee_GetStatus: implemented-entry=Fee_GetStatus
        Fee_GetJobResult: implemented-entry=Fee_GetJobResult
        Fee_InvalidateBlock: implemented-entry=Fee_InvalidateBlock
        Fee_EraseImmediateBlock: implemented-entry=Fee_EraseImmediateBlock
        Fee_17_GetCycleCount: implemented-entry=Fee_17_GetCycleCount
        Fee_17_EnableGcStart: implemented-entry=Fee_17_EnableGcStart
        Fee_17_DisableGcStart: implemented-entry=Fee_17_DisableGcStart
        Fee_17_GetPrevData: implemented-entry=Fee_17_GetPrevData
      bsw schedulable entity Fee_MainFunction: implemented-entry=Fee_MainFunction
      bsw timing event TimingEvent_Fee_MainFunction: starts-on-event=Fee_MainFunction, period=0.01
package /AUTOSAR_Fee/BswModuleEntrys
  17 x bsw module entry, all with is-reentrant=false, sw-service-impl-policy=STANDARD:
    Fee_Init: service-id=0, is-synchronous=true, call-type=REGULAR, execution-context=UNSPECIFIED
    Fee_SetMode: service-id=1, is-synchronous=true, call-type=REGULAR, execution-context=UNSPECIFIED
      sw service arg Mode: implementation-data-type=MemIf_ModeType
    Fee_Read: service-id=2, is-synchronous=false, call-type=REGULAR, execution-context=UNSPECIFIED
      return type Return: implementation-data-type=Std_ReturnType
      4 x sw service arg:
        BlockNumber: implementation-data-type=uint16
        BlockOffset: implementation-data-type=uint16
        DataBufferPtr: category=DATA_REFERENCE, sw-pointer-target-props={target-category=TYPE_REFERENCE, implementation-data-type=uint8}
        Length: implementation-data-type=uint16
    Fee_Write: service-id=3, is-synchronous=false, call-type=REGULAR, execution-context=UNSPECIFIED
      return type Return: implementation-data-type=Std_ReturnType
      sw service arg BlockNumber: implementation-data-type=uint16
      sw service arg DataBufferPtr: category=DATA_REFERENCE, sw-pointer-target-props={target-category=TYPE_REFERENCE, implementation-data-type=uint8}
    Fee_Cancel: service-id=4, is-synchronous=false, call-type=REGULAR, execution-context=UNSPECIFIED
    Fee_GetStatus: service-id=5, is-synchronous=true, call-type=REGULAR, execution-context=UNSPECIFIED
      return type Return: implementation-data-type=MemIf_StatusType
    Fee_GetJobResult: service-id=6, is-synchronous=true, call-type=REGULAR, execution-context=UNSPECIFIED
      return type Return: implementation-data-type=MemIf_JobResultType
    Fee_InvalidateBlock: service-id=7, is-synchronous=false, call-type=REGULAR, execution-context=UNSPECIFIED
      return type Return: implementation-data-type=Std_ReturnType
      sw service arg BlockNumber: implementation-data-type=uint16
    Fee_EraseImmediateBlock: service-id=9, is-synchronous=false, call-type=REGULAR, execution-context=UNSPECIFIED
      return type Return: implementation-data-type=Std_ReturnType
      sw service arg BlockNumber: implementation-data-type=uint16
    Fee_JobEndNotification: service-id=16, is-synchronous=true, call-type=CALLBACK, execution-context=UNSPECIFIED
    Fee_JobErrorNotification: service-id=17, is-synchronous=true, call-type=CALLBACK, execution-context=UNSPECIFIED
    Fee_17_GetCycleCount: service-id=0, is-synchronous=true, call-type=REGULAR, execution-context=UNSPECIFIED
      return type Return: implementation-data-type=Std_ReturnType
      sw service arg BlockNumber: implementation-data-type=uint16
      sw service arg CountPtr: category=DATA_REFERENCE, sw-pointer-target-props={target-category=TYPE_REFERENCE, implementation-data-type=uint32}
    Fee_17_EnableGcStart: service-id=0, is-synchronous=true, call-type=REGULAR, execution-context=UNSPECIFIED
    Fee_17_DisableGcStart: service-id=0, is-synchronous=true, call-type=REGULAR, execution-context=UNSPECIFIED
    Fee_MainFunction: service-id=18, is-synchronous=true, call-type=SCHEDULED, execution-context=TASK
    Fee_17_GetPrevData: service-id=0, is-synchronous=true, call-type=REGULAR, execution-context=UNSPECIFIED
      return type Return: implementation-data-type=Std_ReturnType
      4 x sw service arg:
        BlockNumber: implementation-data-type=uint16
        BlockOffset: implementation-data-type=uint16
        DataBufferPtr: category=DATA_REFERENCE, sw-pointer-target-props={target-category=TYPE_REFERENCE, implementation-data-type=uint8}
        Length: implementation-data-type=uint16
    Fee_IllegalStateNotification: service-id=0, is-synchronous=true, call-type=CALLBACK, execution-context=UNSPECIFIED
package /AUTOSAR_Fee/Implementations
  bsw implementation Fee: programming-language=C, sw-version=0.0.0, vendor-id=17, ar-release-version=4.0.3, behavior=FeeBehavior, vendor-specific-module-def=Fee
    code-descriptors:
      code Files
        artifact-descriptors:
          short-label=ssc::inc::Fee.h, category=SWHDR
          short-label=ssc::inc::Fee_Dbg.h, category=SWHDR
          short-label=ssc::inc::Fee_Cbk.h, category=SWHDR
          short-label=ssc::src::Fee.c, category=SWSRC
          short-label=ssc::src::Fee_Ver.c, category=SWSRC
          short-label=ssc::mak::infineon_fee_cfg.mak, category=SWMAKE
          short-label=ssc::mak::infineon_fee_check.mak, category=SWMAKE
          short-label=ssc::mak::infineon_fee_defs.mak, category=SWMAKE
          short-label=ssc::mak::infineon_fee_rules.mak, category=SWMAKE
    compiler TASKING_COMPILE: name=TASKING, options="-c --core=tc1.6.x -t -Wa-gAHLs --emit-locals=-equ,-symbols -Wa-Ogs -Wa--error-limit=42 --iso=90 --eabi-compliant --integer-enumeration --language=-comments,-gcc,+volatile,-strings --switch=auto --align=0 --default-near-size=0 --default-a0-size=0 --default-a1-size=0 -O2ROPYG --tradeoff=4 -g --source -D_TASKING_C_TRICORE_=1 $(CALLFUNCTION)", vendor=Tasking, version=Tasking
    compiler DIAB_COMPILE: name=DIAB, options="-c -tTC27xAstep16PMG:cross -Xdialect-c89 -Xno-common -Xalign-functions=4 -Xfp-fast -Xsection-split=1 -Xkeep-assembly-file=2 -g3 -ew4084 -ei4177,4550,4549,4068,5388 -XO -D_DIABDATA_C_TRICORE_=1 $(CALLFUNCTION)", vendor=WindRiver, version=WindRiver
    compiler GNU_COMPILE:
      name=GNU
      options="-c -save-temps=obj -std=iso9899:1990 -ansi -fno-asm -ffreestanding -Wundef -Wp,-std=iso9899:1990 -fno-short-enums -fpeel-loops -falign-functions=4 -frecord-gcc-switches -fsection-anchors -funsigned-bitfields -ffunction-sections -fno-ivopts -fno-peephole2 -nostartfiles -O3 -g3 -W -Wall -Wuninitialized -DTRIBOARD_TC27XX -mcpu=tc27xx -D_GNU_C_TRICORE_=1 $(CALLFUNCTION)"
      vendor=Hightec
      version=Hightec
    generated-artifacts:
      4 x dependency on artifact, all with usages=CODEGENERATION:
        Fee_Cfg_h: artifact-descriptor={short-label=generate::inc::Fee_Cfg.h, category=SWHDR}
        Fee_PBCfg_c: artifact-descriptor={short-label=generate::src::Fee_PBCfg.c, category=SWSRC}
        Fee_xdm: artifact-descriptor={short-label=config::Fee.xdm, category=SWTOOL}
        Fee_bmd: artifact-descriptor={short-label=autosar::Fee.bmd, category=SWTOOL}
    linker TASKING_LINK: name=TASKING, options="-t -d_mcal_pjt.lsl -D__CPU__=tc27x -Cmpe:vtc -Otxycl --error-limit=42 -M -mcrfiklsmnoduq -lc -lfp -lrt", vendor=Tasking, version=Tasking
    linker DIAB_LINK: name=DIAB, options="-m6 "_mcal_pjt.dld" -lc", vendor=WindRiver, version=WindRiver
    linker GNU_LINK: name=GNU, options="-T"_mcal_pjt.ld" -nostartfiles -Wl,--allow-multiple-definition -Wl,--cref -Wl,--oformat=elf32-tricore -Wl,--mcpu=tc161 -Wl,--mem-holes -Wl,--extmap="a"", vendor=Hightec, version=Hightec
    resource consumption ResourceConsumption
      7 x memory section:
        FEE_CODE: alignment=UNSPECIFIED, size=12344, sw-addrmethod=CODE
        FEE_JOBENDNOTIF_CODE: alignment=UNSPECIFIED, size=230, sw-addrmethod=CODE
        FEE_JOBERRNOTIF_CODE: alignment=UNSPECIFIED, size=204, sw-addrmethod=CODE
        FEE_VAR_FAST_UNSPECIFIED: alignment=UNSPECIFIED, size=2008, sw-addrmethod=VAR
        FEE_CONST_UNSPECIFIED: alignment=UNSPECIFIED, size=48, sw-addrmethod=CONFIG_DATA
        FEE_SPL_VAR_32BIT: alignment=32, size=4, sw-addrmethod=VAR
        FEE_ILLEGALNOTIF_CODE: alignment=UNSPECIFIED, size=16, sw-addrmethod=CODE
      section name prefix FEE
package /AUTOSAR_Fee/ImplementationDataTypes
  impl type Fee_ConfigType: category=STRUCTURE, type-emitter=BSW
    element Fee_StateDataType
