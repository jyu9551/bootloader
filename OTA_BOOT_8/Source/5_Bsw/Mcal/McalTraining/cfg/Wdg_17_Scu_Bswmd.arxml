AUTOSAR XML (schema 4-0-3)
# Copyright (C) Infineon Technologies (2015)
# All rights reserved.
package /AUTOSAR_Wdg/BswModuleDescriptions
  bsw module description Wdg: category=BSW_MODULE, module-id=102, provided-entrys=[Wdg_Init, Wdg_SetMode, Wdg_GetVersionInfo, Wdg_SetTriggerCondition, Wdg_Cbk_GtmNotificationSRV]  # WDG Driver
    bsw module dependency DetDependency: target-module-id=15, required-entrys=Det_ReportError
    bsw module dependency DemDependency: target-module-id=54, required-entrys=Dem_ReportErrorStatus
    bsw internal behavior WdgBehavior
      6 x exclusive area:
        TimerHandling
        ChangeMode
        SafetyInit
        SafetyTrigger
        SafetyOffMode
        Trigger
      static-memorys:
        data Wdg_TimeoutCounter: implementation-data-type=uint32, type=uint32
        data Wdg_DriverState: implementation-data-type=Wdg_17_Scu_StatusType, type=Wdg_17_Scu_StatusType
        data Wdg_DriverMode: implementation-data-type=WdgIf_ModeType, type=WdgIf_ModeType
      5 x bsw called entity:
        Wdg_Init: can-enter-exclusive-area=[TimerHandling, ChangeMode, SafetyInit], implemented-entry=Wdg_Init
        Wdg_SetMode: can-enter-exclusive-area=TimerHandling, implemented-entry=Wdg_SetMode
        Wdg_GetVersionInfo: implemented-entry=Wdg_GetVersionInfo
        Wdg_SetTriggerCondition: can-enter-exclusive-area=[TimerHandling, Trigger, ChangeMode], implemented-entry=Wdg_SetTriggerCondition
        Wdg_Cbk_GtmNotificationSRV: can-enter-exclusive-area=Trigger, implemented-entry=Wdg_Cbk_GtmNotificationSRV
package /AUTOSAR_Wdg/BswModuleEntrys
  5 x bsw module entry, all with is-reentrant=false, is-synchronous=true, call-type=REGULAR:
    Wdg_Init: service-id=0, execution-context=TASK, sw-service-impl-policy=STANDARD
      sw service arg ConfigPtr: category=DATA_REFERENCE, sw-pointer-target-props={target-category=TYPE_REFERENCE, implementation-data-type=Wdg_ConfigType}
    Wdg_SetMode: service-id=1, execution-context=TASK, sw-service-impl-policy=STANDARD
      return type Return: implementation-data-type=Std_ReturnType
      sw service arg Mode: implementation-data-type=WdgIf_ModeType
    Wdg_GetVersionInfo: service-id=4, execution-context=UNSPECIFIED, sw-service-impl-policy=MACRO
      sw service arg VersionInfoPtr: category=DATA_REFERENCE, sw-pointer-target-props={target-category=TYPE_REFERENCE, implementation-data-type=Std_VersionInfoType}
    Wdg_SetTriggerCondition: service-id=3, execution-context=TASK, sw-service-impl-policy=STANDARD
      sw service arg timeout: implementation-data-type=uint16
    Wdg_Cbk_GtmNotificationSRV: service-id=5, execution-context=TASK, sw-service-impl-policy=STANDARD
package /AUTOSAR_Wdg/Implementations
  bsw implementation Wdg: programming-language=C, sw-version=0.0.0, vendor-id=17, ar-release-version=4.0.3, behavior=WdgBehavior, vendor-api-infix=Scu, vendor-specific-module-def=Wdg
    code-descriptors:
      code Files
        artifact-descriptors:
          short-label=ssc::src::Wdg_17_Scu.c, category=SWSRC
          short-label=ssc::src::Wdg_17_Scu_Safe.c, category=SWSRC
          short-label=ssc::inc::Wdg_17_Scu_Safe.h, category=SWHDR
          short-label=ssc::inc::Wdg_17_Scu.h, category=SWHDR
          short-label=mak::wdg_17_scu_infineon_tricore::ssc::mak::infineon_wdg_17_scu_cfg.mak, category=SWMAKE
          short-label=mak::wdg_17_scu_infineon_tricore::ssc::mak::infineon_wdg_17_scu_check.mak, category=SWMAKE
          short-label=mak::wdg_17_scu_infineon_tricore::ssc::mak::infineon_wdg_17_scu_defs.mak, category=SWMAKE
          short-label=mak::wdg_17_scu_infineon_tricore::ssc::mak::infineon_wdg_17_scu_rules.mak, category=SWMAKE
    compiler TASKING_COMPILE: name=TASKING, options="-c --core=tc1.6.x -t -Wa-gAHLs --emit-locals=-equ,-symbols -Wa-Ogs -Wa--error-limit=42 --iso=90 --eabi-compliant --integer-enumeration --language=-comments,-gcc,+volatile,-strings --switch=auto --align=0 --default-near-size=0 --default-a0-size=0 --default-a1-size=0 -O2ROPYG --tradeoff=4 -g --source -D_TASKING_C_TRICORE_=1 $(CALLFUNCTION)", vendor=Tasking, version=Tasking
    compiler DIAB_COMPILE: name=DIAB, options="-c -tTC27xAstep16PMG:cross -Xdialect-c89 -Xno-common -Xalign-functions=4 -Xfp-fast -Xsection-split=1 -Xkeep-assembly-file=2 -g3 -ew4084 -ei4177,4550,4549,4068,5388 -XO -D_DIABDATA_C_TRICORE_=1 $(CALLFUNCTION)", vendor=WindRiver, version=WindRiver
    compiler GNU_COMPILE:
      name=GNU
      options="-c -save-temps=obj -std=iso9899:1990 -ansi -fno-asm -ffreestanding -Wundef -Wp,-std=iso9899:1990 -fno-short-enums -fpeel-loops -falign-functions=4 -frecord-gcc-switches -fsection-anchors -funsigned-bitfields -ffunction-sections -fno-ivopts -fno-peephole2 -nostartfiles -O3 -g3 -W -Wall -Wuninitialized -DTRIBOARD_TC27XX -mcpu=tc27xx -D_GNU_C_TRICORE_=1 $(CALLFUNCTION)"
      vendor=Hightec
      version=Hightec
    generated-artifacts:
      4 x dependency on artifact, all with usages=CODEGENERATION:
        Wdg_PBCfg_c: artifact-descriptor={short-label=generate::src::Wdg_17_Scu_PBCfg.c, category=SWSRC}
        Wdg_Cfg_h: artifact-descriptor={short-label=generate::inc::Wdg_17_Scu_Cfg.h, category=SWHDR}
        Wdg_xdm: artifact-descriptor={short-label=config::Wdg_17_Scu.xdm, category=SWTOOL}
        Wdg_bmd: artifact-descriptor={short-label=autosar::Wdg_17_Scu.bmd, category=SWTOOL}
    linker TASKING_LINK: name=TASKING, options="-t -d_mcal_pjt.lsl -D__CPU__=tc27x -Cmpe:vtc -Otxycl --error-limit=42 -M -mcrfiklsmnoduq -lc -lfp -lrt", vendor=Tasking, version=Tasking
    linker DIAB_LINK: name=DIAB, options="-m6 "_mcal_pjt.dld" -lc", vendor=WindRiver, version=WindRiver
    linker GNU_LINK: name=GNU, options="-T"_mcal_pjt.ld" -nostartfiles -Wl,--allow-multiple-definition -Wl,--cref -Wl,--oformat=elf32-tricore -Wl,--mcpu=tc161 -Wl,--mem-holes -Wl,--extmap="a"", vendor=Hightec, version=Hightec
    resource consumption ResourceConsumption
      6 x memory section:
        WDG_17_SCU_CONST_32BIT: alignment=32, size=4, sw-addrmethod=CONST
        WDG_17_SCU_VAR_32BIT: alignment=32, size=4, sw-addrmethod=VAR
        WDG_17_SCU_VAR_16BIT: alignment=16, size=12, sw-addrmethod=VAR
        WDG_17_SCU_VAR_UNSPECIFIED: alignment=UNSPECIFIED, size=6, sw-addrmethod=VAR
        WDG_17_SCU_POSTBUILDCFG: alignment=UNSPECIFIED, size=48, sw-addrmethod=CONFIG_DATA
        WDG_17_SCU_CODE: alignment=32, size=1682, sw-addrmethod=CODE
      section name prefix WDG_17_SCU
package /AUTOSAR_Wdg/ImplementationDataTypes
  4 x impl type, all with type-emitter=BSW:
    Wdg_17_Scu_ConfigType: category=STRUCTURE
      element WdgIf_ModeType
    WdgIf_ModeType: compu {0=WDGIF_OFF_MODE, 0=WDGIF_SLOW_MODE, 0=WDGIF_FAST_MODE, 0=WDGIF_NO_MODE}, implementation-data-type=uint32
    Wdg_17_Scu_StatusType: compu {0=WDG_UNINIT, 0=WDG_IDLE, 0=WDG_BUSY}, implementation-data-type=uint32
    Wdg_17_Scu_GtmSettingsType: category=STRUCTURE
      element Wdg_17_Scu_GtmValueType
