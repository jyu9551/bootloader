AUTOSAR XML (schema 4-0-3)
# Copyright (C) Infineon Technologies (2015)
# All rights reserved.
package /AUTOSAR_Lin/BswModuleDescriptions
  bsw module description Lin: category=BSW_MODULE, module-id=82  # LIN Driver
    provided-entrys:
      Lin_Init
      Lin_WakeupValidation
      Lin_SendFrame
      Lin_GoToSleep
      Lin_GoToSleepInternal
      Lin_Wakeup
      Lin_GetStatus
      Lin_IsrReceive
      Lin_IsrTransmit
      Lin_IsrError
    bsw module dependency DetDependency: target-module-id=20, required-entrys=Det_ReportError
    bsw module dependency EcuMDependency: target-module-id=10, required-entrys=[EcuM_SetWakeupEvent, EcuM_CheckWakeup]
    bsw internal behavior LinBehavior
      static-memorys:
        data Lin_ChannelInfo: implementation-data-type=Lin_ChannelInfoType, type=Lin_ChannelInfoType
      7 x bsw called entity:
        Lin_Init: implemented-entry=Lin_Init
        Lin_WakeupValidation: implemented-entry=Lin_WakeupValidation
        Lin_SendFrame: implemented-entry=Lin_SendFrame
        Lin_GoToSleep: implemented-entry=Lin_GoToSleep
        Lin_GoToSleepInternal: implemented-entry=Lin_GoToSleepInternal
        Lin_Wakeup: implemented-entry=Lin_Wakeup
        Lin_GetStatus: implemented-entry=Lin_GetStatus
      bsw interrupt entity Lin_IsrReceive: implemented-entry=Lin_IsrReceive, interrupt-category=CAT-1, interrupt-source=SRC_ASCLINmRX
      bsw interrupt entity Lin_IsrTransmit: implemented-entry=Lin_IsrTransmit, interrupt-category=CAT-1, interrupt-source=SRC_ASCLINmTX
      bsw interrupt entity Lin_IsrError: implemented-entry=Lin_IsrError, interrupt-category=CAT-1, interrupt-source=SRC_ASCLINmEX
package /AUTOSAR_Lin/BswModuleEntrys
  10 x bsw module entry, all with sw-service-impl-policy=STANDARD:
    Lin_Init: service-id=0, is-reentrant=false, is-synchronous=true, call-type=REGULAR, execution-context=UNSPECIFIED
      sw service arg Config: category=DATA_REFERENCE, sw-pointer-target-props={target-category=TYPE_REFERENCE, implementation-data-type=Lin_ConfigType}
    Lin_WakeupValidation: service-id=10, is-reentrant=false, is-synchronous=true, call-type=REGULAR, execution-context=UNSPECIFIED
    Lin_SendFrame: service-id=4, is-reentrant=false, is-synchronous=false, call-type=REGULAR, execution-context=UNSPECIFIED
      return type Return: implementation-data-type=Std_ReturnType
      sw service arg Channel: implementation-data-type=uint8
      sw service arg PduInfoPtr: category=DATA_REFERENCE, sw-pointer-target-props={target-category=TYPE_REFERENCE, implementation-data-type=Lin_PduType}
    Lin_GoToSleep: service-id=6, is-reentrant=false, is-synchronous=false, call-type=REGULAR, execution-context=UNSPECIFIED
      return type Return: implementation-data-type=Std_ReturnType
      sw service arg Channel: implementation-data-type=uint8
    Lin_GoToSleepInternal: service-id=9, is-reentrant=false, is-synchronous=true, call-type=REGULAR, execution-context=UNSPECIFIED
      return type Return: implementation-data-type=Std_ReturnType
      sw service arg Channel: implementation-data-type=uint8
    Lin_Wakeup: service-id=7, is-reentrant=false, is-synchronous=false, call-type=REGULAR, execution-context=UNSPECIFIED
      return type Return: implementation-data-type=Std_ReturnType
      sw service arg Channel: implementation-data-type=uint8
    Lin_GetStatus: service-id=8, is-reentrant=false, is-synchronous=true, call-type=REGULAR, execution-context=UNSPECIFIED
      return type Return: implementation-data-type=Lin_StatusType
      sw service arg Channel: implementation-data-type=uint8
      sw service arg Lin_SduPtr: category=DATA_REFERENCE, sw-pointer-target-props={target-category=TYPE_REFERENCE, implementation-data-type=uint8}
    Lin_IsrReceive: service-id=0, is-reentrant=true, is-synchronous=true, call-type=INTERRUPT, execution-context=INTERRUPT-CAT-1
      sw service arg HwUnit: implementation-data-type=uint8
    Lin_IsrTransmit: service-id=0, is-reentrant=true, is-synchronous=true, call-type=INTERRUPT, execution-context=INTERRUPT-CAT-1
      sw service arg HwUnit: implementation-data-type=uint8
    Lin_IsrError: service-id=0, is-reentrant=true, is-synchronous=true, call-type=INTERRUPT, execution-context=INTERRUPT-CAT-1
      sw service arg HwUnit: implementation-data-type=uint8
package /AUTOSAR_Lin/Implementations
  bsw implementation Lin: programming-language=C, sw-version=0.0.0, vendor-id=17, ar-release-version=4.0.3, behavior=LinBehavior, vendor-api-infix=AscLin, vendor-specific-module-def=Lin
    code-descriptors:
      code Files
        artifact-descriptors:
          short-label=ssc::src::Lin_17_AscLin.c, category=SWSRC
          short-label=ssc::inc::Lin_17_AscLin.h, category=SWHDR
          short-label=mak::lin_17_asclin_infineon_tricore::ssc::mak::infineon_lin_17_asclin_cfg.mak, category=SWMAKE
          short-label=mak::lin_17_asclin_infineon_tricore::ssc::mak::infineon_lin_17_asclin_check.mak, category=SWMAKE
          short-label=mak::lin_17_asclin_infineon_tricore::ssc::mak::infineon_lin_17_asclin_defs.mak, category=SWMAKE
          short-label=mak::lin_17_asclin_infineon_tricore::ssc::mak::infineon_lin_17_asclin_rules.mak, category=SWMAKE
    compiler TASKING_COMPILE: name=TASKING, options="-c --core=tc1.6.x -t -Wa-gAHLs --emit-locals=-equ,-symbols -Wa-Ogs -Wa--error-limit=42 --iso=90 --eabi-compliant --integer-enumeration --language=-comments,-gcc,+volatile,-strings --switch=auto --align=0 --default-near-size=0 --default-a0-size=0 --default-a1-size=0 -O2ROPYG --tradeoff=4 -g --source -D_TASKING_C_TRICORE_=1 $(CALLFUNCTION)", vendor=Tasking, version=Tasking
    compiler DIAB_COMPILE: name=DIAB, options="-c -tTC27xAstep16PMG:cross -Xdialect-c89 -Xno-common -Xalign-functions=4 -Xfp-fast -Xsection-split=1 -Xkeep-assembly-file=2 -g3 -ew4084 -ei4177,4550,4549,4068,5388 -XO -D_DIABDATA_C_TRICORE_=1 $(CALLFUNCTION)", vendor=WindRiver, version=WindRiver
    compiler GNU_COMPILE:
      name=GNU
      options="-c -save-temps=obj -std=iso9899:1990 -ansi -fno-asm -ffreestanding -Wundef -Wp,-std=iso9899:1990 -fno-short-enums -fpeel-loops -falign-functions=4 -frecord-gcc-switches -fsection-anchors -funsigned-bitfields -ffunction-sections -fno-ivopts -fno-peephole2 -nostartfiles -O3 -g3 -W -Wall -Wuninitialized -DTRIBOARD_TC27XX -mcpu=tc27xx -D_GNU_C_TRICORE_=1 $(CALLFUNCTION)"
      vendor=Hightec
      version=Hightec
    generated-artifacts:
      5 x dependency on artifact, all with usages=CODEGENERATION:
        Lin_Cfg_h: artifact-descriptor={short-label=generate::inc::Lin_17_AscLin_Cfg.h, category=SWHDR}
        Lin_PBcfg_c: artifact-descriptor={short-label=generate::src::Lin_17_AscLin_PBcfg.c, category=SWSRC}
        Lin_xdm: artifact-descriptor={short-label=Config::Lin_17_AscLin.xdm, category=SWTOOL}
        plugin_xml: artifact-descriptor={short-label=Lin_17_AscLin_Aurix::plugin.xml, category=SWTOOL}
        Lin_bmd: artifact-descriptor={short-label=autosar::Lin_17_AscLin.bmd, category=SWTOOL}
    linker TASKING_LINK: name=TASKING, options="-t -d_mcal_pjt.lsl -D__CPU__=tc27x -Cmpe:vtc -Otxycl --error-limit=42 -M -mcrfiklsmnoduq -lc -lfp -lrt", vendor=Tasking, version=Tasking
    linker DIAB_LINK: name=DIAB, options="-m6 "_mcal_pjt.dld" -lc", vendor=WindRiver, version=WindRiver
    linker GNU_LINK: name=GNU, options="-T"_mcal_pjt.ld" -nostartfiles -Wl,--allow-multiple-definition -Wl,--cref -Wl,--oformat=elf32-tricore -Wl,--mcpu=tc161 -Wl,--mem-holes -Wl,--extmap="a"", vendor=Hightec, version=Hightec
    resource consumption ResourceConsumption
      6 x memory section:
        LIN_17_ASCLIN_CODE: alignment=UNSPECIFIED, size=3298, sw-addrmethod=CODE
        LIN_17_ASCLIN_VAR_8BIT: alignment=8, size=41, sw-addrmethod=VAR
        LIN_17_ASCLIN_VAR_16BIT: alignment=16, size=8, sw-addrmethod=VAR
        LIN_17_ASCLIN_VAR_32BIT: alignment=32, size=18, sw-addrmethod=VAR
        LIN_17_ASCLIN_VAR_UNSPECIFIED: alignment=UNSPECIFIED, size=60, sw-addrmethod=VAR
        LIN_17_ASCLIN_CONST_32BIT: alignment=32, size=18, sw-addrmethod=CONST
      section name prefix LIN_17_ASCLIN
package /AUTOSAR_Lin/ImplementationDataTypes
  4 x impl type, all with type-emitter=BSW:
    Lin_ChannelInfoType: category=STRUCTURE
      element Lin_IntStatusType
    Lin_ConfigType: category=STRUCTURE
      element Lin_17_AscLin_ChannelType
    Lin_PduType: category=STRUCTURE
      element Lin_FramePidType
    Lin_StatusType: compu {0=LIN_NOT_OK, 0=LIN_TX_OK, 0=LIN_TX_BUSY, 0=LIN_TX_HEADER_ERROR, 0=LIN_TX_ERROR, 0=LIN_RX_OK, 0=LIN_RX_BUSY, 0=LIN_RX_ERROR, 0=LIN_RX_NO_RESPONSE, 0=LIN_OPERATIONAL, 0=LIN_CH_SLEEP, 0=LIN_TX_HEADER_TIMEOUT_ERROR, 0=LIN_RX_RESPONSE_TIMEOUT_ERROR}, implementation-data-type=uint32
