AUTOSAR XML (schema 4-0-3)
# Copyright (C) Infineon Technologies (2015)
# All rights reserved.
package /AUTOSAR_Fls/BswModuleDescriptions
  bsw module description Fls: category=BSW_MODULE, module-id=92  # FLS Driver
    provided-entrys:
      Fls_Init
      Fls_Erase
      Fls_Write
      Fls_Compare
      Fls_MainFunction
      Fls_Read
      Fls_GetStatus
      Fls_GetJobResult
      Fls_ReadWordsSync
      Fls_CompareWordsSync
      Fls_VerifyErase
      Fls_GetNotifCaller
      Fls_CancelNonEraseJobs
      Fls_GetBankStatus
      Fls_SuspendErase
      Fls_ResumeErase
      Fls_GetOperStatus
      Fls_ControlTimeoutDet
    bsw module dependency DetDependency: target-module-id=15, required-entrys=Det_ReportError
    bsw module dependency DemDependency: target-module-id=54, required-entrys=Dem_ReportErrorStatus
    bsw internal behavior FlsBehavior
      constant-memorys:
        parameter data prototype Fls_ConfigPtr: category=DATA_REFERENCE, sw-pointer-target-props={target-category=TYPE_REFERENCE, implementation-data-type=Fls_17_Pmu_ConfigType}, type=Fls_17_Pmu_ConfigType
      5 x exclusive area:
        Init
        Erase
        Write
        Main
        ResumeErase
      static-memorys:
        data FlsStateVar: implementation-data-type=Fls_StateType, type=Fls_StateType
      17 x bsw called entity:
        Fls_Init: can-enter-exclusive-area=Init, implemented-entry=Fls_Init
        Fls_Erase: can-enter-exclusive-area=Erase, implemented-entry=Fls_Erase
        Fls_Write: can-enter-exclusive-area=Write, implemented-entry=Fls_Write
        Fls_Compare: implemented-entry=Fls_Compare
        Fls_Read: implemented-entry=Fls_Read
        Fls_GetStatus: implemented-entry=Fls_GetStatus
        Fls_GetJobResult: implemented-entry=Fls_GetJobResult
        Fls_ReadWordsSync: implemented-entry=Fls_ReadWordsSync
        Fls_CompareWordsSync: implemented-entry=Fls_CompareWordsSync
        Fls_VerifyErase: implemented-entry=Fls_VerifyErase
        Fls_GetNotifCaller: implemented-entry=Fls_GetNotifCaller
        Fls_CancelNonEraseJobs: implemented-entry=Fls_CancelNonEraseJobs
        Fls_GetBankStatus: implemented-entry=Fls_GetBankStatus
        Fls_SuspendErase: implemented-entry=Fls_SuspendErase
        Fls_ResumeErase: can-enter-exclusive-area=ResumeErase, implemented-entry=Fls_ResumeErase
        Fls_GetOperStatus: implemented-entry=Fls_GetOperStatus
        Fls_ControlTimeoutDet: implemented-entry=Fls_ControlTimeoutDet
      bsw schedulable entity Fls_MainFunction: can-enter-exclusive-area=Main, implemented-entry=Fls_MainFunction
      bsw timing event TimingEvent_Fls_MainFunction: starts-on-event=Fls_MainFunction, period=0.01
package /AUTOSAR_Fls/BswModuleEntrys
  18 x bsw module entry, all with sw-service-impl-policy=STANDARD:
    Fls_Init: service-id=0, is-reentrant=false, is-synchronous=true, call-type=REGULAR, execution-context=UNSPECIFIED
      sw service arg ConfigPtr: category=DATA_REFERENCE, sw-pointer-target-props={target-category=TYPE_REFERENCE, implementation-data-type=Fls_ConfigType}
    Fls_Erase: service-id=1, is-reentrant=false, is-synchronous=false, call-type=REGULAR, execution-context=UNSPECIFIED
      return type Return: implementation-data-type=Std_ReturnType
      sw service arg TargetAddress: implementation-data-type=Fls_AddressType
      sw service arg Length: implementation-data-type=Fls_LengthType
    Fls_Write: service-id=2, is-reentrant=false, is-synchronous=false, call-type=REGULAR, execution-context=UNSPECIFIED
      return type Return: implementation-data-type=Std_ReturnType
      sw service arg TargetAddress: implementation-data-type=Fls_AddressType
      sw service arg SourceAddressPtr: category=DATA_REFERENCE, sw-pointer-target-props={target-category=TYPE_REFERENCE, implementation-data-type=uint8}
      sw service arg Length: implementation-data-type=Fls_LengthType
    Fls_Compare: service-id=8, is-reentrant=false, is-synchronous=false, call-type=REGULAR, execution-context=UNSPECIFIED
      return type Return: implementation-data-type=Std_ReturnType
      sw service arg SourceAddress: implementation-data-type=Fls_AddressType
      sw service arg TargetAddressPtr: category=DATA_REFERENCE, sw-pointer-target-props={target-category=TYPE_REFERENCE, implementation-data-type=uint8}
      sw service arg Length: implementation-data-type=Fls_LengthType
    Fls_MainFunction: service-id=6, is-reentrant=false, is-synchronous=true, call-type=SCHEDULED, execution-context=TASK
    Fls_Read: service-id=7, is-reentrant=false, is-synchronous=false, call-type=REGULAR, execution-context=UNSPECIFIED
      return type Return: implementation-data-type=Std_ReturnType
      sw service arg SourceAddress: implementation-data-type=Fls_AddressType
      sw service arg TargetAddressPtr: category=DATA_REFERENCE, sw-pointer-target-props={target-category=TYPE_REFERENCE, implementation-data-type=uint8}
      sw service arg Length: implementation-data-type=Fls_LengthType
    Fls_GetStatus: service-id=4, is-reentrant=true, is-synchronous=true, call-type=REGULAR, execution-context=UNSPECIFIED
      return type Return: implementation-data-type=MemIf_StatusType
    Fls_GetJobResult: service-id=5, is-reentrant=true, is-synchronous=true, call-type=REGULAR, execution-context=UNSPECIFIED
      return type Return: implementation-data-type=MemIf_JobResultType
    Fls_ReadWordsSync: service-id=0, is-reentrant=false, is-synchronous=true, call-type=REGULAR, execution-context=UNSPECIFIED
      return type Return: implementation-data-type=Std_ReturnType
      sw service arg SourceAddress: implementation-data-type=Fls_AddressType
      sw service arg TargetAddressPtr: category=DATA_REFERENCE, sw-pointer-target-props={target-category=TYPE_REFERENCE, implementation-data-type=uint32}
      sw service arg Length: implementation-data-type=uint32
    Fls_CompareWordsSync: service-id=0, is-reentrant=false, is-synchronous=true, call-type=REGULAR, execution-context=UNSPECIFIED
      return type Return: implementation-data-type=Std_ReturnType
      sw service arg SourceAddress: implementation-data-type=Fls_AddressType
      sw service arg TargetAddressPtr: category=DATA_REFERENCE, sw-pointer-target-props={target-category=TYPE_REFERENCE, implementation-data-type=uint32}
      sw service arg Length: implementation-data-type=uint32
    Fls_VerifyErase: service-id=0, is-reentrant=false, is-synchronous=true, call-type=REGULAR, execution-context=UNSPECIFIED
      return type Return: implementation-data-type=Std_ReturnType
      sw service arg BankNum: implementation-data-type=uint32
      sw service arg UnerasedWordlineAddressPtr: category=DATA_REFERENCE, sw-pointer-target-props={target-category=TYPE_REFERENCE, implementation-data-type=uint32}
      sw service arg UnerasedWordlineCountPtr: category=DATA_REFERENCE, sw-pointer-target-props={target-category=TYPE_REFERENCE, implementation-data-type=uint8}
    Fls_GetNotifCaller: service-id=0, is-reentrant=false, is-synchronous=true, call-type=REGULAR, execution-context=UNSPECIFIED
      return type Return: implementation-data-type=Fls_Job_Type
    Fls_CancelNonEraseJobs: service-id=0, is-reentrant=false, is-synchronous=true, call-type=REGULAR, execution-context=UNSPECIFIED
    Fls_GetBankStatus: service-id=0, is-reentrant=true, is-synchronous=true, call-type=REGULAR, execution-context=UNSPECIFIED
      return type Return: implementation-data-type=MemIf_StatusType
      sw service arg BankNum: implementation-data-type=uint32
    Fls_SuspendErase: service-id=0, is-reentrant=false, is-synchronous=true, call-type=REGULAR, execution-context=UNSPECIFIED
      return type Return: implementation-data-type=Std_ReturnType
      sw service arg BankNum: implementation-data-type=uint32
    Fls_ResumeErase: service-id=0, is-reentrant=false, is-synchronous=true, call-type=REGULAR, execution-context=UNSPECIFIED
      return type Return: implementation-data-type=Std_ReturnType
      sw service arg BankNum: implementation-data-type=uint32
    Fls_GetOperStatus: service-id=0, is-reentrant=false, is-synchronous=true, call-type=REGULAR, execution-context=UNSPECIFIED
      return type Return: implementation-data-type=Std_ReturnType
    Fls_ControlTimeoutDet: service-id=0, is-reentrant=false, is-synchronous=true, call-type=REGULAR, execution-context=UNSPECIFIED
      sw service arg Param: implementation-data-type=uint8
package /AUTOSAR_Fls/Implementations
  bsw implementation Fls: programming-language=C, sw-version=0.0.0, vendor-id=17, ar-release-version=4.0.3, behavior=FlsBehavior, vendor-api-infix=Pmu, vendor-specific-module-def=Fls
    code-descriptors:
      code Files
        artifact-descriptors:
          short-label=ssc::src::Fls_17_Pmu.c, category=SWSRC
          short-label=ssc::src::Fls_17_Pmu_Ver.c, category=SWSRC
          short-label=ssc::inc::Fls_17_Pmu.h, category=SWHDR
          short-label=ssc::inc::Fls_17_Pmu_Local.h, category=SWHDR
          short-label=ssc::src::Fls_17_Pmu_ac.c, category=SWSRC
          short-label=ssc::inc::Fls_17_Pmu_ac.h, category=SWHDR
          short-label=ssc::mak::infineon_fls_17_pmu_cfg.mak, category=SWMAKE
          short-label=ssc::mak::infineon_fls_17_pmu_check.mak, category=SWMAKE
          short-label=ssc::mak::infineon_fls_17_pmu_defs.mak, category=SWMAKE
          short-label=ssc::mak::infineon_fls_17_pmu_rules.mak, category=SWMAKE
    compiler TASKING_COMPILE: name=TASKING, options="-c --core=tc1.6.x -t -Wa-gAHLs --emit-locals=-equ,-symbols -Wa-Ogs -Wa--error-limit=42 --iso=90 --eabi-compliant --integer-enumeration --language=-comments,-gcc,+volatile,-strings --switch=auto --align=0 --default-near-size=0 --default-a0-size=0 --default-a1-size=0 -O2ROPYG --tradeoff=4 -g --source -D_TASKING_C_TRICORE_=1 $(CALLFUNCTION)", vendor=Tasking, version=Tasking
    compiler DIAB_COMPILE: name=DIAB, options="-c -tTC27xAstep16PMG:cross -Xdialect-c89 -Xno-common -Xalign-functions=4 -Xfp-fast -Xsection-split=1 -Xkeep-assembly-file=2 -g3 -ew4084 -ei4177,4550,4549,4068,5388 -XO -D_DIABDATA_C_TRICORE_=1 $(CALLFUNCTION)", vendor=WindRiver, version=WindRiver
    compiler GNU_COMPILE:
      name=GNU
      options="-c -save-temps=obj -std=iso9899:1990 -ansi -fno-asm -ffreestanding -Wundef -Wp,-std=iso9899:1990 -fno-short-enums -fpeel-loops -falign-functions=4 -frecord-gcc-switches -fsection-anchors -funsigned-bitfields -ffunction-sections -fno-ivopts -fno-peephole2 -nostartfiles -O3 -g3 -W -Wall -Wuninitialized -DTRIBOARD_TC27XX -mcpu=tc27xx -D_GNU_C_TRICORE_=1 $(CALLFUNCTION)"
      vendor=Hightec
      version=Hightec
    generated-artifacts:
      4 x dependency on artifact, all with usages=CODEGENERATION:
        Fls_xdm: artifact-descriptor={short-label=config::Fls_17_Pmu.xdm, category=SWTOOL}
        Fls_bmd: artifact-descriptor={short-label=autosar::Fls_17_Pmu.bmd, category=SWTOOL}
        Fls_PBCfg_c: artifact-descriptor={short-label=generate::src::Fls_17_Pmu_PBCfg.c, category=SWSRC}
        Fls_Cfg_h: artifact-descriptor={short-label=generate::inc::Fls_17_Pmu_Cfg.h, category=SWHDR}
    linker TASKING_LINK: name=TASKING, options="-t -d_mcal_pjt.lsl -D__CPU__=tc27x -Cmpe:vtc -Otxycl --error-limit=42 -M -mcrfiklsmnoduq -lc -lfp -lrt", vendor=Tasking, version=Tasking
    linker DIAB_LINK: name=DIAB, options="-m6 "_mcal_pjt.dld" -lc", vendor=WindRiver, version=WindRiver
    linker GNU_LINK: name=GNU, options="-T"_mcal_pjt.ld" -nostartfiles -Wl,--allow-multiple-definition -Wl,--cref -Wl,--oformat=elf32-tricore -Wl,--mcpu=tc161 -Wl,--mem-holes -Wl,--extmap="a"", vendor=Hightec, version=Hightec
    resource consumption ResourceConsumption
      7 x memory section:
        FLS_17_PMU_CODE: alignment=UNSPECIFIED, size=4264, sw-addrmethod=CODE
        FLS_17_PMU_SPL_CODE_WRITECMD_BEGIN: alignment=UNSPECIFIED, size=198, sw-addrmethod=CODE
        FLS_17_PMU_SPL_CODE_ERASECMD_BEGIN: alignment=UNSPECIFIED, size=136, sw-addrmethod=CODE
        FLS_17_PMU_VAR_32BIT: alignment=32, size=4, sw-addrmethod=VAR
        FLS_17_PMU_CONST_32BIT: alignment=32, size=4, sw-addrmethod=CONST
        FLS_17_PMU_VAR_UNSPECIFIED: alignment=UNSPECIFIED, size=44, sw-addrmethod=VAR
        FLS_17_PMU_POSTBUILDCFG: alignment=UNSPECIFIED, size=48, sw-addrmethod=CONFIG_DATA
      section name prefix FLS_17_PMU
package /AUTOSAR_Fls/ImplementationDataTypes
  5 x impl type, all with type-emitter=BSW:
    Fls_17_Pmu_ConfigType: category=STRUCTURE
      element Fls_17_Pmu_StateType
    Fls_StateType: category=STRUCTURE
      element uint32
    Fls_AddressType: implementation-data-type=uint32
    Fls_LengthType: implementation-data-type=uint32
    Fls_Job_Type: implementation-data-type=uint8
